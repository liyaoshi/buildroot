## package/gstreamer1/gst-plugin-ducati/Config.in
```kconfig
config BR2_PACKAGE_GST_PLUGIN_DUCATI
	bool "gst-ducati"
	help
	  GStreamer plug-in to use ti-ducati

	  http://cgit.freedesktop.org/gstreamer/gst-omx
```

## package/gstreamer1/gstreamer-imx/Config.in
```kconfig
config BR2_PACKAGE_GSTREAMER_IMX
	bool "gstreamer-imx"
	help
	  http://github.com/freescale/
```

## package/ipcdev/Config.in
```kconfig
config BR2_PACKAGE_IPCDEV
	bool "ipcdev"
	help
	  Kernel modules for TI CPUs with SGX GPU.
	  This package supports AM335x, AM437x, AM4430 and AM5430.
	  It builds the kernel module and the user space binaries.
	  For older CPUs or kernels use the ti-gfx package.

	  Note: it needs a TI specific kernel to build properly.

	  http://git.ti.com/graphics/omap5-sgx-ddk-linux
```

## package/libgbm/Config.in
```kconfig
config BR2_PACKAGE_LIBGBM
	bool "libgbm"
	help
	  https://github.com/robclark/libgbm.git
```

## package/libspectre/Config.in
```kconfig
config BR2_PACKAGE_LIBSPECTRE
	bool "libspectre"
	help
	  libsperctre from freedesktop
```

## package/poppler-data/Config.in
```kconfig
config BR2_PACKAGE_POPPLER_DATA
	bool "poppler-data"
	help

	  http://poppler.freedesktop.org/
```

## package/ti-gc320-driver/Config.in
```kconfig
config BR2_PACKAGE_TI_GC320_DRIVER
	bool "ti-gc320-driver"
	depends on BR2_LINUX_KERNEL && BR2_arm
	select BR2_LINUX_NEEDS_MODULES
	help
	ti-gc320-driver
```

## package/ti-gc320-lib/Config.in
```kconfig
config BR2_PACKAGE_TI_GC320_LIB
	bool "ti-gc320-lib"
	depends on BR2_PACKAGE_TI_SGX_KM
	depends on BR2_TOOLCHAIN_HAS_THREADS # libdrm
	# pre-built binaries
	depends on BR2_TOOLCHAIN_USES_GLIBC
	select BR2_PACKAGE_LIBDRM_OMAP
	select BR2_PACKAGE_HAS_LIBEGL
	select BR2_PACKAGE_HAS_LIBGLES
	select BR2_PACKAGE_HAS_POWERVR
	help
	  Graphics libraries for TI CPUs with SGX5xx GPU.
	  This package supports AM335x, AM437x, AM4430 and AM5430.
	  For older CPUs or kernels use the ti-gfx package.

	  http://git.ti.com/graphics/omap5-sgx-ddk-um-linux
```
